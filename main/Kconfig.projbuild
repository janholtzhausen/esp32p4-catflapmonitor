## main/Kconfig.projbuild
```kconfig
menu "Catflapcam Configuration"
    
    config CATFLAPCAM_CAMERA_VIDEO_BUFFER_NUMBER
        int "Camera video buffer number"
        default 3
        help
            Number of video buffers for the camera sensor.
            
            More buffers provide better performance and reduce frame drops,
            but consume more memory. Recommended range: 2-4 buffers.
            
            - 2 buffers: Minimum for basic operation
            - 3-4 buffers: Better performance for smooth streaming
            - Higher values: May improve performance but increase memory usage

    config CATFLAPCAM_JPEG_COMPRESSION_QUALITY
        int "JPEG compression quality (%)"
        default 95
        range 1 100
        help
            JPEG compression quality percentage (1-100).

            Higher values produce better image quality but larger data streams:
            - 90-100: Excellent quality, high bandwidth usage
            - 70-90: Good quality, moderate bandwidth (recommended for UVC)
            - 50-70: Acceptable quality, lower bandwidth
            - 1-50: Poor quality, minimal bandwidth

            For UVC streaming, consider the USB bandwidth limitations
            and host system capabilities when choosing quality level.

            Recommended: 80 for balanced quality and performance.

    config CATFLAPCAM_HTTP_PART_BOUNDARY
        string "HTTP part boundary"
        default "123456789000000000000987654321"
        help
            HTTP multipart boundary string used for MJPEG streaming.
            
            This boundary separates different parts in the HTTP multipart response.
            Must be unique and not appear in the video data. The default value
            is designed to be unique and safe for most applications.
    
    config CATFLAPCAM_MDNS_INSTANCE
        string "mDNS instance"
        default "web-cam"
        help
            mDNS instance name for service discovery.
            
            This name will be used to identify the camera service on the network.
            Other devices can discover this camera using this instance name
            through mDNS/Bonjour protocols.
    
    config CATFLAPCAM_MDNS_HOST_NAME
        string "mDNS host name"
        default "esp-web"
        help
            mDNS host name for the ESP32 device.
            
            This hostname will be used for network identification and can be
            accessed as "esp-web.local" on the local network (if mDNS is supported
            by the client device).

    config CATFLAPCAM_ULTRASONIC_TRIGGER_ENABLE
        bool "Enable ultrasonic trigger snapshot capture"
        default n
        help
            Enable distance-based automatic image capture/snapshot save using an HC-SR04 style
            ultrasonic sensor. When enabled, the firmware periodically measures distance and
            triggers /api/capture_image behavior when an object comes near.

    config CATFLAPCAM_ULTRASONIC_TRIG_GPIO
        int "Ultrasonic TRIG GPIO"
        default 4
        depends on CATFLAPCAM_ULTRASONIC_TRIGGER_ENABLE
        help
            GPIO connected to the sensor TRIG pin.

    config CATFLAPCAM_ULTRASONIC_ECHO_GPIO
        int "Ultrasonic ECHO GPIO"
        default 5
        depends on CATFLAPCAM_ULTRASONIC_TRIGGER_ENABLE
        help
            GPIO connected to the sensor ECHO pin.

    config CATFLAPCAM_ULTRASONIC_TRIGGER_DISTANCE_CM
        int "Ultrasonic trigger distance (cm)"
        default 30
        range 2 400
        depends on CATFLAPCAM_ULTRASONIC_TRIGGER_ENABLE
        help
            Auto-capture is triggered when measured distance is less than or equal to this value.

    config CATFLAPCAM_ULTRASONIC_MIN_INTERVAL_MS
        int "Minimum interval between ultrasonic captures (ms)"
        default 3000
        range 250 60000
        depends on CATFLAPCAM_ULTRASONIC_TRIGGER_ENABLE
        help
            Debounce interval to avoid repeated captures while an object remains in range.

    config CATFLAPCAM_ULTRASONIC_SOURCE_INDEX
        int "Camera index used by ultrasonic trigger"
        default 0
        range 0 3
        depends on CATFLAPCAM_ULTRASONIC_TRIGGER_ENABLE
        help
            Camera source index used for automatic captures.
endmenu
```

## sdkconfig.defaults.esp32p4
```kconfig
CONFIG_CAMERA_SC2336=y

CONFIG_IDF_EXPERIMENTAL_FEATURES=y

CONFIG_SPIRAM=y
CONFIG_SPIRAM_SPEED_200M=y

CONFIG_ESP_VIDEO_ENABLE_ISP_PIPELINE_CONTROLLER=y

CONFIG_CATFLAPCAM_SELECT_CUSTOMIZED_DEV_BOARD=y
```
